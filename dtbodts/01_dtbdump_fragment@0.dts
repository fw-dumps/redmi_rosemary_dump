/dts-v1/;

/ {

	__fixups__ {
		accdet = "/fragment@12:target:0";
		auxadc = "/fragment@24:target:0", "/fragment@25/__overlay__:io-channels:0";
		chosen = "/fragment@9:target:0";
		consys = "/fragment@21:target:0";
		dsi_te = "/fragment@46:target:0";
		fpsensor_finger = "/fragment@6:target:0";
		fpsensor_fp_eint = "/fragment@41:target:0";
		gpio = "/fragment@38:target:0";
		gpio_usage_mapping = "/fragment@37:target:0";
		i2c0 = "/fragment@0:target:0", "/fragment@27:target:0";
		i2c1 = "/fragment@28:target:0";
		i2c2 = "/fragment@10:target:0", "/fragment@29:target:0";
		i2c3 = "/fragment@30:target:0";
		i2c4 = "/fragment@31:target:0";
		i2c5 = "/fragment@32:target:0";
		i2c6 = "/fragment@33:target:0", "/fragment@60:target:0", "/fragment@61:target:0";
		i2c7 = "/fragment@34:target:0";
		i2c8 = "/fragment@35:target:0";
		i2c9 = "/fragment@36:target:0", "/fragment@62:target:0";
		irq_nfc = "/fragment@45:target:0";
		irtx_pwm = "/fragment@22:target:0";
		kd_camera_hw1 = "/fragment@53:target:0", "/fragment@57:target:0", "/fragment@59:target:0";
		keypad = "/fragment@55:target:0";
		main_pmic = "/fragment@49:target:0";
		md1_sim1_hot_plug_eint = "/fragment@50:target:0";
		md_auxadc = "/fragment@25:target:0";
		mrdump_ext_rst = "/fragment@39:target:0";
		msdc1_ins = "/fragment@43:target:0";
		mt6360_pmu = "/fragment@16:target:0";
		mt6360_typec = "/fragment@18:target:0";
		mt_pmic_vcamio_ldo_reg = "/fragment@51:target:0", "/fragment@53/__overlay__:vcamio-supply:0", "/fragment@53/__overlay__:vcamio_sub-supply:0", "/fragment@53/__overlay__:vcamio_main2-supply:0", "/fragment@53/__overlay__:vcamaf-supply:0", "/fragment@53/__overlay__:vcamaf_main2-supply:0", "/fragment@57/__overlay__:cam0_vcamio-supply:0", "/fragment@57/__overlay__:cam1_vcamio-supply:0", "/fragment@57/__overlay__:cam2_vcamio-supply:0";
		mt_pmic_vfp_ldo_reg = "/fragment@5/__overlay__/fpc_tee@0:#vfp-supply:0";
		mt_pmic_vtp_ldo_reg = "/fragment@0/__overlay__/goodix-gtx8@5d:vtouch-supply:0", "/fragment@0/__overlay__/touch@0:vtouch-supply:0", "/fragment@3/__overlay__:vtouch-supply:0", "/fragment@52:target:0", "/fragment@54/__overlay__:vtouch-supply:0";
		mtkfb = "/fragment@15:target:0";
		odm = "/fragment@13:target:0";
		pio = "/fragment@0/__overlay__/goodix-gtx8@5d:interrupt-parent:0", "/fragment@0/__overlay__/goodix-gtx8@5d:goodix,reset-gpio:0", "/fragment@0/__overlay__/goodix-gtx8@5d:goodix,irq-gpio:0", "/fragment@0/__overlay__/touch@0:interrupt-parent:0", "/fragment@0/__overlay__/touch@0:focaltech,reset-gpio:0", "/fragment@0/__overlay__/touch@0:focaltech,irq-gpio:0", "/fragment@3/__overlay__:interrupt-parent:0", "/fragment@3/__overlay__:focaltech,eint-gpio:0", "/fragment@3/__overlay__:focaltech,reset-gpio:0", "/fragment@4:target:0", "/fragment@7:target:0", "/fragment@14:target:0", "/fragment@16/__overlay__:mt6360,intr_gpio:0", "/fragment@18/__overlay__:mt6360pd,intr_gpio:0", "/fragment@18/__overlay__:mt6360pd,pcb_gpio:0", "/fragment@19:target:0", "/fragment@20:target:0", "/fragment@23:target:0", "/fragment@37/__overlay__:GPIO_SIM1_SIO:0", "/fragment@37/__overlay__:GPIO_SIM1_SRST:0", "/fragment@37/__overlay__:GPIO_SIM1_SCLK:0", "/fragment@37/__overlay__:GPIO_SIM2_SCLK:0", "/fragment@37/__overlay__:GPIO_SIM2_SRST:0", "/fragment@37/__overlay__:GPIO_SIM2_SIO:0", "/fragment@37/__overlay__:GPIO_SIM1_HOT_PLUG:0", "/fragment@39/__overlay__:interrupt-parent:0", "/fragment@39/__overlay__:deb-gpios:0", "/fragment@40/__overlay__:interrupt-parent:0", "/fragment@41/__overlay__:interrupt-parent:0", "/fragment@42/__overlay__:interrupt-parent:0", "/fragment@43/__overlay__:interrupt-parent:0", "/fragment@44/__overlay__:interrupt-parent:0", "/fragment@45/__overlay__:interrupt-parent:0", "/fragment@46/__overlay__:interrupt-parent:0", "/fragment@47/__overlay__:interrupt-parent:0", "/fragment@47/__overlay__:deb-gpios:0", "/fragment@48/__overlay__:interrupt-parent:0", "/fragment@48/__overlay__:deb-gpios:0", "/fragment@49/__overlay__:interrupt-parent:0", "/fragment@56:target:0", "/fragment@58:target:0", "/fragment@60/__overlay__/wl2866d@28:en-gpio:0", "/fragment@62/__overlay__/aw87xxx_pa_5B@5B:reset-gpio:0";
		pmic_clock_buffer_ctrl = "/fragment@26:target:0";
		reserved_memory = "/fragment@8:target:0";
		spi0 = "/fragment@5:target:0";
		spi3 = "/fragment@11:target:0";
		subpmic_pmu_eint = "/fragment@44:target:0";
		swtp = "/fragment@47:target:0";
		swtp_1 = "/fragment@48:target:0";
		tcpc_pd = "/fragment@42:target:0";
		thermal_message = "/fragment@17:target:0";
		touch = "/fragment@3:target:0", "/fragment@40:target:0", "/fragment@54:target:0";
		xiaomi_touch = "/fragment@1:target:0", "/fragment@2:target:0";
	};

	__local_fixups__ {

		fragment@0 {

			__overlay__ {
				pinctrl-0 = <0x0>;
				pinctrl-1 = <0x0>;
				pinctrl-2 = <0x0>;
				pinctrl-3 = <0x0>;
				pinctrl-4 = <0x0>;
				pinctrl-5 = <0x0>;
				pinctrl-6 = <0x0>;
			};
		};

		fragment@13 {

			__overlay__ {

				camera_af_hw_node {
					pinctrl-0 = <0x0>;
					pinctrl-1 = <0x0>;
				};

				usb_c_pinctrl {
					pinctrl-0 = <0x0>;
					pinctrl-1 = <0x0>;
					pinctrl-10 = <0x0>;
					pinctrl-11 = <0x0>;
					pinctrl-12 = <0x0>;
					pinctrl-2 = <0x0>;
					pinctrl-3 = <0x0>;
					pinctrl-4 = <0x0>;
					pinctrl-5 = <0x0>;
					pinctrl-6 = <0x0>;
					pinctrl-7 = <0x0>;
					pinctrl-8 = <0x0>;
					pinctrl-9 = <0x0>;
				};
			};
		};

		fragment@15 {

			__overlay__ {
				pinctrl-0 = <0x0>;
				pinctrl-1 = <0x0>;
				pinctrl-10 = <0x0>;
				pinctrl-2 = <0x0>;
				pinctrl-3 = <0x0>;
				pinctrl-4 = <0x0>;
				pinctrl-5 = <0x0>;
				pinctrl-6 = <0x0>;
				pinctrl-7 = <0x0>;
				pinctrl-8 = <0x0>;
				pinctrl-9 = <0x0>;
			};
		};

		fragment@21 {

			__overlay__ {
				pinctrl-0 = <0x0>;
				pinctrl-1 = <0x0>;
				pinctrl-2 = <0x0>;
				pinctrl-3 = <0x0>;
			};
		};

		fragment@22 {

			__overlay__ {
				pinctrl-0 = <0x0>;
				pinctrl-1 = <0x0>;
			};
		};

		fragment@57 {

			__overlay__ {
				cam0_vcama-supply = <0x0>;
				cam0_vcamd-supply = <0x0>;
				cam1_vcama-supply = <0x0>;
				cam1_vcamd-supply = <0x0>;
				cam2_vcama-supply = <0x0>;
				cam2_vcamd-supply = <0x0>;
				cam3_vcama-supply = <0x0>;
				cam4_vcama-supply = <0x0>;
				pinctrl-0 = <0x0>;
				pinctrl-1 = <0x0>;
				pinctrl-10 = <0x0>;
				pinctrl-11 = <0x0>;
				pinctrl-12 = <0x0>;
				pinctrl-13 = <0x0>;
				pinctrl-14 = <0x0>;
				pinctrl-15 = <0x0>;
				pinctrl-16 = <0x0>;
				pinctrl-17 = <0x0>;
				pinctrl-18 = <0x0>;
				pinctrl-19 = <0x0>;
				pinctrl-2 = <0x0>;
				pinctrl-20 = <0x0>;
				pinctrl-21 = <0x0>;
				pinctrl-22 = <0x0>;
				pinctrl-23 = <0x0>;
				pinctrl-24 = <0x0>;
				pinctrl-25 = <0x0>;
				pinctrl-26 = <0x0>;
				pinctrl-27 = <0x0>;
				pinctrl-28 = <0x0>;
				pinctrl-29 = <0x0>;
				pinctrl-3 = <0x0>;
				pinctrl-30 = <0x0>;
				pinctrl-31 = <0x0>;
				pinctrl-32 = <0x0>;
				pinctrl-33 = <0x0>;
				pinctrl-34 = <0x0>;
				pinctrl-35 = <0x0>;
				pinctrl-36 = <0x0>;
				pinctrl-37 = <0x0>;
				pinctrl-38 = <0x0>;
				pinctrl-39 = <0x0>;
				pinctrl-4 = <0x0>;
				pinctrl-40 = <0x0>;
				pinctrl-41 = <0x0>;
				pinctrl-5 = <0x0>;
				pinctrl-6 = <0x0>;
				pinctrl-7 = <0x0>;
				pinctrl-8 = <0x0>;
				pinctrl-9 = <0x0>;
			};
		};

		fragment@6 {

			__overlay__ {
				pinctrl-0 = <0x0>;
				pinctrl-1 = <0x0>;
			};
		};
	};

	__symbols__ {
		cam0_ldo_vcamaf_0 = "/fragment@58/__overlay__/cam0_ldo_vcamaf_output_low@gpio34";
		cam0_ldo_vcamaf_1 = "/fragment@58/__overlay__/cam0_ldo_vcamaf_output_high@gpio34";
		camera0_mclk_2ma = "/fragment@56/__overlay__/camera0_mclk_2ma@gpio116";
		camera0_mclk_4ma = "/fragment@56/__overlay__/camera0_mclk_4ma@gpio116";
		camera0_mclk_6ma = "/fragment@56/__overlay__/camera0_mclk_6ma@gpio116";
		camera0_mclk_8ma = "/fragment@56/__overlay__/camera0_mclk_8ma@gpio116";
		camera0_mclk_off = "/fragment@56/__overlay__/camera0_mclk_gpio_mode@gpio116";
		camera0_rst_high = "/fragment@56/__overlay__/camera0_rst_output_high@gpio118";
		camera0_rst_low = "/fragment@56/__overlay__/camera0_rst_output_low@gpio118";
		camera1_mclk_2ma = "/fragment@56/__overlay__/camera1_mclk_2ma@gpio120";
		camera1_mclk_4ma = "/fragment@56/__overlay__/camera1_mclk_4ma@gpio120";
		camera1_mclk_6ma = "/fragment@56/__overlay__/camera1_mclk_6ma@gpio120";
		camera1_mclk_8ma = "/fragment@56/__overlay__/camera1_mclk_8ma@gpio120";
		camera1_mclk_off = "/fragment@56/__overlay__/camera1_mclk_gpio_mode@gpio120";
		camera1_mipisel_off = "/fragment@56/__overlay__/camera1_mipisel_off@gpio21";
		camera1_mipisel_on = "/fragment@56/__overlay__/camera1_mipisel_on@gpio21";
		camera1_rst_high = "/fragment@56/__overlay__/camera1_rst_output_high@gpio124";
		camera1_rst_low = "/fragment@56/__overlay__/camera1_rst_output_low@gpio124";
		camera2_mclk_2ma = "/fragment@56/__overlay__/camera2_mclk_2ma@gpio121";
		camera2_mclk_4ma = "/fragment@56/__overlay__/camera2_mclk_4ma@gpio121";
		camera2_mclk_6ma = "/fragment@56/__overlay__/camera2_mclk_6ma@gpio121";
		camera2_mclk_8ma = "/fragment@56/__overlay__/camera2_mclk_8ma@gpio121";
		camera2_mclk_off = "/fragment@56/__overlay__/camera2_mclk_gpio_mode@gpio121";
		camera2_rst_high = "/fragment@56/__overlay__/camera2_rst_output_high@gpio125";
		camera2_rst_low = "/fragment@56/__overlay__/camera2_rst_output_low@gpio125";
		camera3_mclk_2ma = "/fragment@56/__overlay__/camera3_mclk_2ma@gpio196";
		camera3_mclk_4ma = "/fragment@56/__overlay__/camera3_mclk_4ma@gpio196";
		camera3_mclk_6ma = "/fragment@56/__overlay__/camera3_mclk_6ma@gpio196";
		camera3_mclk_8ma = "/fragment@56/__overlay__/camera3_mclk_8ma@gpio196";
		camera3_mclk_off = "/fragment@56/__overlay__/camera3_mclk_gpio_mode@gpio196";
		camera3_rst_high = "/fragment@56/__overlay__/camera3_rst_output_high@gpio197";
		camera3_rst_low = "/fragment@56/__overlay__/camera3_rst_output_low@gpio197";
		camera3_vcamio_off = "/fragment@56/__overlay__/camera3_vcamio_output_low@gpio22";
		camera3_vcamio_on = "/fragment@56/__overlay__/camera3_vcamio_output_high@gpio22";
		camera4_mclk_2ma = "/fragment@56/__overlay__/camera4_mclk_2ma@gpio117";
		camera4_mclk_4ma = "/fragment@56/__overlay__/camera4_mclk_4ma@gpio117";
		camera4_mclk_6ma = "/fragment@56/__overlay__/camera4_mclk_6ma@gpio117";
		camera4_mclk_8ma = "/fragment@56/__overlay__/camera4_mclk_8ma@gpio117";
		camera4_mclk_off = "/fragment@56/__overlay__/camera4_mclk_gpio_mode@gpio117";
		camera4_rst_high = "/fragment@56/__overlay__/camera4_rst_output_high@gpio119";
		camera4_rst_low = "/fragment@56/__overlay__/camera4_rst_output_low@gpio119";
		camera4_vcamio_off = "/fragment@56/__overlay__/camera4_vcamio_output_low@gpio22";
		camera4_vcamio_on = "/fragment@56/__overlay__/camera4_vcamio_output_high@gpio22";
		camera_af_hw_node = "/fragment@13/__overlay__/camera_af_hw_node";
		camera_af_node = "/fragment@13/__overlay__/camera_af_node";
		camera_main_af_mtk = "/fragment@29/__overlay__/camera_main_af@0c";
		camera_main_eeprom_mtk = "/fragment@29/__overlay__/camera_main_eeprom@50";
		camera_main_mtk = "/fragment@29/__overlay__/camera_main@1a";
		camera_main_three_eeprom_mtk = "/fragment@29/__overlay__/camera_main_three_eeprom@52";
		camera_main_three_mtk = "/fragment@29/__overlay__/camera_main_three@3a";
		camera_main_two_eeprom_mtk = "/fragment@31/__overlay__/camera_main_two_eeprom@11";
		camera_main_two_mtk = "/fragment@31/__overlay__/camera_main_two@10";
		camera_pins_default = "/fragment@56/__overlay__/camdefault";
		camera_sub_eeprom_mtk = "/fragment@31/__overlay__/camera_sub_eeprom@52";
		camera_sub_mtk = "/fragment@31/__overlay__/camera_sub@2d";
		camera_sub_two_mtk = "/fragment@31/__overlay__/camera_sub_two@21";
		ccu_sensor_i2c_2_hw_mtk = "/fragment@29/__overlay__/ccu_sensor_i2c_2_hw@33";
		ccu_sensor_i2c_4_hw_mtk = "/fragment@31/__overlay__/ccu_sensor_i2c_4_hw@36";
		ccu_sensor_i2c_7_hw_mtk = "/fragment@34/__overlay__/ccu_sensor_i2c_7_hw@43";
		consys_pins_default = "/fragment@20/__overlay__/consys_default";
		ctp_pins_default = "/fragment@4/__overlay__/eintdefault";
		ctp_ts_i2c_mode = "/fragment@4/__overlay__/i2cmode_default";
		ctp_ts_int_active = "/fragment@4/__overlay__/int_active";
		ctp_ts_int_as_gpio = "/fragment@4/__overlay__/int_high";
		ctp_ts_int_suspend = "/fragment@4/__overlay__/int_suspend";
		ctp_ts_reset_active = "/fragment@4/__overlay__/reset_active";
		ctp_ts_reset_suspend = "/fragment@4/__overlay__/reset_suspend";
		fpsensor_fpc_rst_high = "/fragment@7/__overlay__/fpsensor_fpc_rst_high";
		fpsensor_fpc_rst_low = "/fragment@7/__overlay__/fpsensor_fpc_rst_low";
		gpio_redriver_c1_high = "/fragment@19/__overlay__/c1_high";
		gpio_redriver_c1_hiz = "/fragment@19/__overlay__/c1_highz";
		gpio_redriver_c1_init = "/fragment@19/__overlay__/c1_init";
		gpio_redriver_c1_low = "/fragment@19/__overlay__/c1_low";
		gpio_redriver_c2_high = "/fragment@19/__overlay__/c2_high";
		gpio_redriver_c2_hiz = "/fragment@19/__overlay__/c2_highz";
		gpio_redriver_c2_init = "/fragment@19/__overlay__/c2_init";
		gpio_redriver_c2_low = "/fragment@19/__overlay__/c2_low";
		gpio_u3_switch_disable = "/fragment@19/__overlay__/u3_sw_dis";
		gpio_u3_switch_enable = "/fragment@19/__overlay__/u3_sw_en";
		gpio_u3_switch_sel1 = "/fragment@19/__overlay__/u3_sw_sel1";
		gpio_u3_switch_sel2 = "/fragment@19/__overlay__/u3_sw_sel2";
		gpslna_pins_init = "/fragment@20/__overlay__/gpslna@0";
		gpslna_pins_oh = "/fragment@20/__overlay__/gpslna@1";
		gpslna_pins_ol = "/fragment@20/__overlay__/gpslna@2";
		i2c_lcd_bias_mtk = "/fragment@33/__overlay__/i2c_lcd_bias@73";
		irtx_gpio_led_default = "/fragment@23/__overlay__/irtx_gpio_led_def@gpio26";
		irtx_gpio_led_set = "/fragment@23/__overlay__/irtx_gpio_led_set@gpio26";
		led0 = "/fragment@13/__overlay__/led@0";
		led1 = "/fragment@13/__overlay__/led@1";
		led2 = "/fragment@13/__overlay__/led@2";
		led3 = "/fragment@13/__overlay__/led@3";
		led4 = "/fragment@13/__overlay__/led@4";
		led5 = "/fragment@13/__overlay__/led@5";
		led6 = "/fragment@13/__overlay__/led@6";
		mtkfb_pins_lcd_bias_enn0 = "/fragment@14/__overlay__/lcd_bias_enn0_gpio";
		mtkfb_pins_lcd_bias_enn1 = "/fragment@14/__overlay__/lcd_bias_enn1_gpio";
		mtkfb_pins_lcd_bias_enp0 = "/fragment@14/__overlay__/lcd_bias_enp0_gpio";
		mtkfb_pins_lcd_bias_enp1 = "/fragment@14/__overlay__/lcd_bias_enp1_gpio";
		mtkfb_pins_lcd_ldo18_out0_gpio = "/fragment@14/__overlay__/lcd_ldo18_out0_gpio";
		mtkfb_pins_lcd_ldo18_out1_gpio = "/fragment@14/__overlay__/lcd_ldo18_out1_gpio";
		mtkfb_pins_lcm_dsi_te = "/fragment@14/__overlay__/lcm_dsi_te";
		mtkfb_pins_lcm_ldo3_out0_gpio = "/fragment@14/__overlay__/lcm_ldo3_out0_gpio";
		mtkfb_pins_lcm_ldo3_out1_gpio = "/fragment@14/__overlay__/lcm_ldo3_out1_gpio";
		mtkfb_pins_lcm_rst_out0_gpio = "/fragment@14/__overlay__/lcm_rst_out0_gpio";
		mtkfb_pins_lcm_rst_out1_gpio = "/fragment@14/__overlay__/lcm_rst_out1_gpio";
		nfc_mtk = "/fragment@30/__overlay__/nfc@08";
		speaker_amp = "/fragment@61/__overlay__/speaker_amp@34";
		spidev3 = "/fragment@11/__overlay__/spi@3";
		subpmic_ldo_mtk = "/fragment@32/__overlay__/subpmic_ldo@64";
		subpmic_mtk = "/fragment@32/__overlay__/subpmic@34";
		subpmic_pmic_mtk = "/fragment@32/__overlay__/subpmic_pmic@1a";
		usb_c_pinctrl = "/fragment@13/__overlay__/usb_c_pinctrl";
		usb_default = "/fragment@19/__overlay__/usb_default";
		usb_type_c_mtk = "/fragment@32/__overlay__/usb_type_c@4e";
		vibrator0 = "/fragment@13/__overlay__/vibrator@0";
		vproc_buck_mtk = "/fragment@36/__overlay__/vproc_buck@6b";
		wl2866d = "/fragment@60/__overlay__/wl2866d@28";
		wl2866d_avdd1 = "/fragment@60/__overlay__/wl2866d@28/wl2866d_avdd1@2";
		wl2866d_avdd2 = "/fragment@60/__overlay__/wl2866d@28/wl2866d_avdd2@3";
		wl2866d_dvdd1 = "/fragment@60/__overlay__/wl2866d@28/wl2866d_dvdd1@0";
		wl2866d_dvdd2 = "/fragment@60/__overlay__/wl2866d@28/wl2866d_dvdd2@1";
	};

	fragment@0 {
		target = <0xffffffff>;

		__overlay__ {
			clock-frequency = <0x61a80>;
			pinctrl-0 = <0x1>;
			pinctrl-1 = <0x2>;
			pinctrl-2 = <0x3>;
			pinctrl-3 = <0x4>;
			pinctrl-4 = <0x5>;
			pinctrl-5 = <0x6>;
			pinctrl-6 = <0x7>;
			pinctrl-names = "default", "ts_int_active", "ts_reset_active", "ts_int_suspend", "ts_reset_suspend", "ts_i2c_mode", "ts_eint_high";

			goodix-gtx8@5d {
				compatible = "goodix,gt9885";
				goodix,avdd-name = "vtouch";
				goodix,irq-flags = <0x2>;
				goodix,irq-gpio = <0xffffffff 0x1 0x0>;
				goodix,key-of-pen = <0x14b 0x14c>;
				goodix,panel-key-map = <0x9e 0xac 0xd9>;
				goodix,panel-max-id = <0xa>;
				goodix,panel-max-p = <0x200>;
				goodix,panel-max-w = <0x200>;
				goodix,panel-max-x = <0x438>;
				goodix,panel-max-y = <0x960>;
				goodix,pen-enable;
				goodix,power-off-delay-us = <0x1388>;
				goodix,power-on-delay-us = <0x493e0>;
				goodix,reset-gpio = <0xffffffff 0x2 0x0>;
				interrupt-parent = <0xffffffff>;
				reg = <0x5d>;
				status = "okay";
				vtouch-supply = <0xffffffff>;
			};

			touch@0 {
				compatible = "focaltech,fts";
				focaltech,display-coords = <0x0 0x0 0x437 0x95f>;
				focaltech,irq-gpio = <0xffffffff 0x1 0x0>;
				focaltech,max-touch-number = <0xa>;
				focaltech,reset-gpio = <0xffffffff 0x2 0x0>;
				interrupt-parent = <0xffffffff>;
				reg = <0x38>;
				status = "okay";
				tpd-filter-custom-prameters = <0x0 0x0 0x0 0x0 0x0 0x0 0x0 0x0 0x0 0x0 0x0 0x0>;
				tpd-filter-custom-speed = <0x0 0x0 0x0>;
				tpd-filter-enable = <0x0>;
				tpd-filter-pixel-density = <0xa1>;
				vtouch-supply = <0xffffffff>;
			};
		};
	};

	fragment@1 {
		target = <0xffffffff>;

		__overlay__ {
			compatible = "xiaomi-touch";
			status = "ok";
			touch,name = "xiaomi-touch";
		};
	};

	fragment@10 {
		target = <0xffffffff>;

		__overlay__ {
			clock-frequency = <0x61a80>;

			mtk-usb@60 {
				compatible = "mediatek,mtk-usb";
				reg = <0x60>;
				status = "okay";
			};
		};
	};

	fragment@11 {
		target = <0xffffffff>;

		__overlay__ {
			status = "okay";

			spi@3 {
				compatible = "ir,ir_spi";
				phandle = <0x58>;
				reg = <0x0>;
				spi-cpol;
				spi-max-frequency = <0xf4240>;
			};
		};
	};

	fragment@12 {
		target = <0xffffffff>;

		__overlay__ {
			accdet-mic-mode = <0x2>;
			accdet-mic-vol = <0x8>;
			accdet-plugout-debounce = <0x1>;
			eint_use_ext_res = <0x0>;
			headset-four-key-threshold = <0x0 0x3a 0x79 0xc0 0x190>;
			headset-mode-setting = <0x500 0x500 0x1 0x1f0 0x800 0x800 0x20 0x44 0x4 0x1 0x5 0x3 0x3 0x5 0xe>;
			headset-three-key-threshold = <0x0 0x50 0xdc 0x190>;
			headset-three-key-threshold-CDD = <0x0 0x79 0xc0 0x258>;
			status = "okay";
		};
	};

	fragment@13 {
		target = <0xffffffff>;

		__overlay__ {

			camera_af_hw_node {
				compatible = "mediatek,camera_af_lens";
				phandle = <0x61>;
				pinctrl-0 = <0xa>;
				pinctrl-1 = <0xb>;
				pinctrl-names = "cam0_ldo_vcamaf_0", "cam0_ldo_vcamaf_1";
				status = "okay";
			};

			camera_af_node {
				compatible = "mediatek,CAMERA_MAIN_AF";
				phandle = <0x62>;
			};

			led@0 {
				compatible = "mediatek,red";
				data = <0x1>;
				led_mode = <0x0>;
				phandle = <0x59>;
				pwm_config = <0x0 0x0 0x0 0x0 0x0>;
			};

			led@1 {
				compatible = "mediatek,green";
				data = <0x1>;
				led_mode = <0x0>;
				phandle = <0x5a>;
				pwm_config = <0x0 0x0 0x0 0x0 0x0>;
			};

			led@2 {
				compatible = "mediatek,blue";
				data = <0x1>;
				led_mode = <0x0>;
				phandle = <0x5b>;
				pwm_config = <0x0 0x0 0x0 0x0 0x0>;
			};

			led@3 {
				compatible = "mediatek,jogball-backlight";
				data = <0x1>;
				led_mode = <0x0>;
				phandle = <0x5c>;
				pwm_config = <0x0 0x0 0x0 0x0 0x0>;
			};

			led@4 {
				compatible = "mediatek,keyboard-backlight";
				data = <0x1>;
				led_mode = <0x0>;
				phandle = <0x5d>;
				pwm_config = <0x0 0x0 0x0 0x0 0x0>;
			};

			led@5 {
				compatible = "mediatek,button-backlight";
				data = <0x1>;
				led_mode = <0x0>;
				phandle = <0x5e>;
				pwm_config = <0x0 0x0 0x0 0x0 0x0>;
			};

			led@6 {
				compatible = "mediatek,lcd-backlight";
				data = <0x1>;
				led_mode = <0x4>;
				phandle = <0x5f>;
				pwm_config = <0x0 0x1 0x0 0x0 0x0>;
			};

			usb_c_pinctrl {
				compatible = "mediatek,usb_c_pinctrl";
				phandle = <0x63>;
				pinctrl-0 = <0xc>;
				pinctrl-1 = <0xd>;
				pinctrl-10 = <0x16>;
				pinctrl-11 = <0x17>;
				pinctrl-12 = <0x18>;
				pinctrl-2 = <0xe>;
				pinctrl-3 = <0xf>;
				pinctrl-4 = <0x10>;
				pinctrl-5 = <0x11>;
				pinctrl-6 = <0x12>;
				pinctrl-7 = <0x13>;
				pinctrl-8 = <0x14>;
				pinctrl-9 = <0x15>;
				pinctrl-names = "usb_default", "redrv_c1_init", "redrv_c1_low", "redrv_c1_hiz", "redrv_c1_high", "redrv_c2_init", "redrv_c2_low", "redrv_c2_hiz", "redrv_c2_high", "switch_sel1", "switch_sel2", "switch_enable", "switch_disable";
				status = "okay";

				usb_switch-data {
					c1_pin_val = <0x2>;
					c2_pin_num = <0x1e>;
					c2_pin_val = <0x1>;
					en_pin_num = <0x0>;
					en_pin_val = <0x0>;
					sel_pin_val = <0x1>;
				};
			};

			vibrator@0 {
				compatible = "mediatek,vibrator";
				phandle = <0x60>;
				vib_limit = <0x9>;
				vib_timer = <0x19>;
				vib_vol = <0x9>;
			};
		};
	};

	fragment@14 {
		target = <0xffffffff>;

		__overlay__ {

			lcd_bias_enn0_gpio {
				phandle = <0x1c>;

				pins_cmd_dat {
					output-low;
					pinmux = <0xca00>;
					slew-rate = <0x1>;
				};
			};

			lcd_bias_enn1_gpio {
				phandle = <0x1b>;

				pins_cmd_dat {
					output-high;
					pinmux = <0xca00>;
					slew-rate = <0x1>;
				};
			};

			lcd_bias_enp0_gpio {
				phandle = <0x1a>;

				pins_cmd_dat {
					output-low;
					pinmux = <0x1700>;
					slew-rate = <0x1>;
				};
			};

			lcd_bias_enp1_gpio {
				phandle = <0x19>;

				pins_cmd_dat {
					output-high;
					pinmux = <0x1700>;
					slew-rate = <0x1>;
				};
			};

			lcd_ldo18_out0_gpio {
				phandle = <0x21>;

				pins_cmd_dat {
					output-low;
					pinmux = <0xe00>;
					slew-rate = <0x1>;
				};
			};

			lcd_ldo18_out1_gpio {
				phandle = <0x20>;

				pins_cmd_dat {
					output-high;
					pinmux = <0xe00>;
					slew-rate = <0x1>;
				};
			};

			lcm_dsi_te {
				phandle = <0x1f>;

				pins_cmd_dat {
					pinmux = <0x2b01>;
				};
			};

			lcm_ldo3_out0_gpio {
				phandle = <0x23>;

				pins_cmd_dat {
					output-low;
					pinmux = <0x7f00>;
					slew-rate = <0x1>;
				};
			};

			lcm_ldo3_out1_gpio {
				phandle = <0x22>;

				pins_cmd_dat {
					output-high;
					pinmux = <0x7f00>;
					slew-rate = <0x1>;
				};
			};

			lcm_rst_out0_gpio {
				phandle = <0x1e>;

				pins_cmd_dat {
					output-low;
					pinmux = <0x2c00>;
					slew-rate = <0x1>;
				};
			};

			lcm_rst_out1_gpio {
				phandle = <0x1d>;

				pins_cmd_dat {
					output-high;
					pinmux = <0x2c00>;
					slew-rate = <0x1>;
				};
			};
		};
	};

	fragment@15 {
		target = <0xffffffff>;

		__overlay__ {
			pinctrl-0 = <0x19>;
			pinctrl-1 = <0x1a>;
			pinctrl-10 = <0x23>;
			pinctrl-2 = <0x1b>;
			pinctrl-3 = <0x1c>;
			pinctrl-4 = <0x1d>;
			pinctrl-5 = <0x1e>;
			pinctrl-6 = <0x1f>;
			pinctrl-7 = <0x20>;
			pinctrl-8 = <0x21>;
			pinctrl-9 = <0x22>;
			pinctrl-names = "lcd_bias_enp1_gpio", "lcd_bias_enp0_gpio", "lcd_bias_enn1_gpio", "lcd_bias_enn0_gpio", "lcm_rst_out1_gpio", "lcm_rst_out0_gpio", "mode_te_te", "lcd_ldo18_out1_gpio", "lcd_ldo18_out0_gpio", "lcm_ldo3_out1_gpio", "lcm_ldo3_out0_gpio";
			status = "okay";
		};
	};

	fragment@16 {
		target = <0xffffffff>;

		__overlay__ {
			mt6360,intr_gpio = <0xffffffff 0x10 0x0>;
			mt6360,intr_gpio_num = <0x10>;
		};
	};

	fragment@17 {
		target = <0xffffffff>;

		__overlay__ {
			board-sensor = "VIRTUAL-SENSOR";
		};
	};

	fragment@18 {
		target = <0xffffffff>;

		__overlay__ {
			mt6360pd,intr_gpio = <0xffffffff 0x7 0x0>;
			mt6360pd,intr_gpio_num = <0x7>;
			mt6360pd,pcb_gpio = <0xffffffff 0x5 0x0>;
			mt6360pd,pcb_gpio_num = <0x5>;
			mt6360pd,pcb_gpio_polarity = <0x1>;
		};
	};

	fragment@19 {
		target = <0xffffffff>;

		__overlay__ {

			c1_high {
				phandle = <0x10>;

				pins_cmd_dat {
					output-high;
					slew-rate = <0x1>;
				};
			};

			c1_highz {
				phandle = <0xf>;

				pins_cmd_dat {
					bias-disable;
					slew-rate = <0x0>;
				};
			};

			c1_init {
				phandle = <0xd>;

				pins_cmd_dat {
					output-low;
					slew-rate = <0x1>;
				};
			};

			c1_low {
				phandle = <0xe>;

				pins_cmd_dat {
					output-low;
					slew-rate = <0x1>;
				};
			};

			c2_high {
				phandle = <0x14>;

				pins_cmd_dat {
					output-high;
					pinmux = <0x1e00>;
					slew-rate = <0x1>;
				};
			};

			c2_highz {
				phandle = <0x13>;

				pins_cmd_dat {
					bias-disable;
					pinmux = <0x1e00>;
					slew-rate = <0x0>;
				};
			};

			c2_init {
				phandle = <0x11>;

				pins_cmd_dat {
					output-low;
					pinmux = <0x1e00>;
					slew-rate = <0x1>;
				};
			};

			c2_low {
				phandle = <0x12>;

				pins_cmd_dat {
					output-low;
					pinmux = <0x1e00>;
					slew-rate = <0x1>;
				};
			};

			u3_sw_dis {
				phandle = <0x18>;
			};

			u3_sw_en {
				phandle = <0x17>;
			};

			u3_sw_sel1 {
				phandle = <0x15>;

				pins_cmd_dat {
					output-low;
					slew-rate = <0x1>;
				};
			};

			u3_sw_sel2 {
				phandle = <0x16>;

				pins_cmd_dat {
					output-high;
					slew-rate = <0x1>;
				};
			};

			usb_default {
				phandle = <0xc>;
			};
		};
	};

	fragment@2 {
		target = <0xffffffff>;

		__overlay__ {
			compatible = "xiaomi-touch";
			status = "ok";
			touch,name = "xiaomi-touch";
		};
	};

	fragment@20 {
		target = <0xffffffff>;

		__overlay__ {

			consys_default {
				phandle = <0x24>;
			};

			gpslna@0 {
				phandle = <0x25>;

				pins_cmd_dat {
					bias-disable;
					output-low;
					pinmux = <0x9b00>;
					slew-rate = <0x0>;
				};
			};

			gpslna@1 {
				phandle = <0x26>;

				pins_cmd_dat {
					output-high;
					pinmux = <0x9b00>;
					slew-rate = <0x1>;
				};
			};

			gpslna@2 {
				phandle = <0x27>;

				pins_cmd_dat {
					output-low;
					pinmux = <0x9b00>;
					slew-rate = <0x1>;
				};
			};
		};
	};

	fragment@21 {
		target = <0xffffffff>;

		__overlay__ {
			pinctrl-0 = <0x24>;
			pinctrl-1 = <0x25>;
			pinctrl-2 = <0x26>;
			pinctrl-3 = <0x27>;
			pinctrl-names = "default", "gps_lna_state_init", "gps_lna_state_oh", "gps_lna_state_ol";
			status = "okay";
		};
	};

	fragment@22 {
		target = <0xffffffff>;

		__overlay__ {
			pinctrl-0 = <0x28>;
			pinctrl-1 = <0x29>;
			pinctrl-names = "irtx_gpio_led_default", "irtx_gpio_led_set";
			status = "okay";
		};
	};

	fragment@23 {
		target = <0xffffffff>;

		__overlay__ {

			irtx_gpio_led_def@gpio26 {
				phandle = <0x28>;

				pins_cmd_dat {
					bias-disable;
					input-schmitt-enable = <0x0>;
					output-low;
					pinmux = <0x1a00>;
					slew-rate = <0x1>;
				};
			};

			irtx_gpio_led_set@gpio26 {
				phandle = <0x29>;

				pins_cmd_dat {
					output-high;
					pinmux = <0x1a01>;
					slew-rate = <0x1>;
				};
			};
		};
	};

	fragment@24 {
		target = <0xffffffff>;

		__overlay__ {

			adc_channel@ {
				compatible = "mediatek,adc_channel";
				mediatek,adc_fdd_rf_params_dynamic_custom_ch = <0x2>;
				mediatek,temperature0 = <0x0>;
				mediatek,temperature1 = <0x1>;
				status = "okay";
			};
		};
	};

	fragment@25 {
		target = <0xffffffff>;

		__overlay__ {
			io-channels = <0xffffffff 0x2>;
		};
	};

	fragment@26 {
		target = <0xffffffff>;

		__overlay__ {
			mediatek,clkbuf-config = <0x2 0x1 0x1 0x2 0x0 0x0 0x1>;
			mediatek,clkbuf-controls-for-desense = <0x0 0x4 0x0 0x3 0x0 0x0 0x0>;
			mediatek,clkbuf-output-impedance = <0x4 0x4 0x4 0x4 0x0 0x0 0x4>;
			mediatek,clkbuf-quantity = <0x7>;
			status = "okay";
		};
	};

	fragment@27 {
		target = <0xffffffff>;

		__overlay__ {
			#address-cells = <0x1>;
			#size-cells = <0x0>;
			clock-frequency = <0x61a80>;
			mediatek,use-open-drain;
		};
	};

	fragment@28 {
		target = <0xffffffff>;

		__overlay__ {
			#address-cells = <0x1>;
			#size-cells = <0x0>;
			clock-frequency = <0x61a80>;
			mediatek,use-open-drain;
		};
	};

	fragment@29 {
		target = <0xffffffff>;

		__overlay__ {
			#address-cells = <0x1>;
			#size-cells = <0x0>;
			clock-frequency = <0x61a80>;
			mediatek,use-open-drain;

			camera_main@1a {
				compatible = "mediatek,camera_main";
				phandle = <0x64>;
				reg = <0x1a>;
				status = "okay";
			};

			camera_main_af@0c {
				compatible = "mediatek,camera_main_af";
				phandle = <0x65>;
				reg = <0xc>;
				status = "okay";
			};

			camera_main_eeprom@50 {
				compatible = "mediatek,camera_main_eeprom";
				phandle = <0x66>;
				reg = <0x50>;
				status = "okay";
			};

			camera_main_three@3a {
				compatible = "mediatek,camera_main_three";
				phandle = <0x68>;
				reg = <0x3a>;
				status = "okay";
			};

			camera_main_three_eeprom@52 {
				compatible = "mediatek,camera_main_three_eeprom";
				phandle = <0x69>;
				reg = <0x52>;
				status = "okay";
			};

			ccu_sensor_i2c_2_hw@33 {
				compatible = "mediatek,ccu_sensor_i2c_2_hw";
				phandle = <0x67>;
				reg = <0x33>;
				status = "okay";
			};
		};
	};

	fragment@3 {
		target = <0xffffffff>;

		__overlay__ {
			focaltech,eint-gpio = <0xffffffff 0x1 0x0>;
			focaltech,reset-gpio = <0xffffffff 0x2 0x0>;
			interrupt-parent = <0xffffffff>;
			interrupts = <0x1 0x2 0x1 0x0>;
			lcm-resolution = <0x438 0x870>;
			status = "okay";
			tpd-cfg-version = "config19";
			tpd-filter-custom-prameters = <0x0 0x0 0x0 0x0 0x0 0x0 0x0 0x0 0x0 0x0 0x0 0x0>;
			tpd-filter-custom-speed = <0x0 0x0 0x0>;
			tpd-filter-enable = <0x0>;
			tpd-filter-pixel-density = <0xa8>;
			tpd-max-touch-num = <0xa>;
			tpd-resolution = <0x438 0x870>;
			vtouch-supply = <0xffffffff>;
		};
	};

	fragment@30 {
		target = <0xffffffff>;

		__overlay__ {
			#address-cells = <0x1>;
			#size-cells = <0x0>;
			clock-frequency = <0x61a80>;
			mediatek,use-open-drain;

			nfc@08 {
				compatible = "mediatek,nfc";
				phandle = <0x6a>;
				reg = <0x8>;
				status = "okay";
			};
		};
	};

	fragment@31 {
		target = <0xffffffff>;

		__overlay__ {
			#address-cells = <0x1>;
			#size-cells = <0x0>;
			clock-frequency = <0x61a80>;
			mediatek,use-open-drain;

			camera_main_two@10 {
				compatible = "mediatek,camera_main_two";
				phandle = <0x6e>;
				reg = <0x10>;
				status = "okay";
			};

			camera_main_two_eeprom@11 {
				compatible = "mediatek,camera_main_two_eeprom";
				phandle = <0x6f>;
				reg = <0x11>;
				status = "okay";
			};

			camera_sub@2d {
				compatible = "mediatek,camera_sub";
				phandle = <0x6c>;
				reg = <0x2d>;
				status = "okay";
			};

			camera_sub_eeprom@52 {
				compatible = "mediatek,camera_sub_eeprom";
				phandle = <0x6d>;
				reg = <0x52>;
				status = "okay";
			};

			camera_sub_two@21 {
				compatible = "mediatek,camera_sub_two";
				phandle = <0x6b>;
				reg = <0x21>;
				status = "okay";
			};

			ccu_sensor_i2c_4_hw@36 {
				compatible = "mediatek,ccu_sensor_i2c_4_hw";
				phandle = <0x70>;
				reg = <0x36>;
				status = "okay";
			};
		};
	};

	fragment@32 {
		target = <0xffffffff>;

		__overlay__ {
			#address-cells = <0x1>;
			#size-cells = <0x0>;
			clock-frequency = <0x33e140>;
			mediatek,use-push-pull;

			subpmic@34 {
				compatible = "mediatek,subpmic";
				phandle = <0x71>;
				reg = <0x34>;
				status = "okay";
			};

			subpmic_ldo@64 {
				compatible = "mediatek,subpmic_ldo";
				phandle = <0x74>;
				reg = <0x64>;
				status = "okay";
			};

			subpmic_pmic@1a {
				compatible = "mediatek,subpmic_pmic";
				phandle = <0x73>;
				reg = <0x1a>;
				status = "okay";
			};

			usb_type_c@4e {
				compatible = "mediatek,usb_type_c";
				phandle = <0x72>;
				reg = <0x4e>;
				status = "okay";
			};
		};
	};

	fragment@33 {
		target = <0xffffffff>;

		__overlay__ {
			#address-cells = <0x1>;
			#size-cells = <0x0>;
			clock-frequency = <0x61a80>;
			mediatek,use-open-drain;

			i2c_lcd_bias@73 {
				compatible = "mediatek,i2c_lcd_bias";
				phandle = <0x75>;
				reg = <0x73>;
				status = "okay";
			};
		};
	};

	fragment@34 {
		target = <0xffffffff>;

		__overlay__ {
			#address-cells = <0x1>;
			#size-cells = <0x0>;
			clock-frequency = <0x61a80>;
			mediatek,use-open-drain;

			ccu_sensor_i2c_7_hw@43 {
				compatible = "mediatek,ccu_sensor_i2c_7_hw";
				phandle = <0x76>;
				reg = <0x43>;
				status = "okay";
			};
		};
	};

	fragment@35 {
		target = <0xffffffff>;

		__overlay__ {
			#address-cells = <0x1>;
			#size-cells = <0x0>;
			clock-frequency = <0x61a80>;
			mediatek,use-open-drain;
		};
	};

	fragment@36 {
		target = <0xffffffff>;

		__overlay__ {
			#address-cells = <0x1>;
			#size-cells = <0x0>;
			clock-frequency = <0x61a80>;
			mediatek,use-open-drain;

			vproc_buck@6b {
				compatible = "mediatek,vproc_buck";
				phandle = <0x77>;
				reg = <0x6b>;
				status = "okay";
			};
		};
	};

	fragment@37 {
		target = <0xffffffff>;

		__overlay__ {
			GPIO_SIM1_HOT_PLUG = <0xffffffff 0x8c 0x0>;
			GPIO_SIM1_SCLK = <0xffffffff 0x82 0x0>;
			GPIO_SIM1_SIO = <0xffffffff 0x80 0x0>;
			GPIO_SIM1_SRST = <0xffffffff 0x81 0x0>;
			GPIO_SIM2_SCLK = <0xffffffff 0x83 0x0>;
			GPIO_SIM2_SIO = <0xffffffff 0x85 0x0>;
			GPIO_SIM2_SRST = <0xffffffff 0x84 0x0>;
		};
	};

	fragment@38 {
		target = <0xffffffff>;

		__overlay__ {
			gpio_init_default = <0x0 0x0 0x0 0x0 0x1 0x1 0x1 0x1 0x0 0x0 0x0 0x1 0x1 0x1 0x2 0x0 0x1 0x0 0x0 0x0 0x1 0x3 0x7 0x0 0x0 0x1 0x0 0x1 0x4 0x0 0x0 0x0 0x1 0x0 0x1 0x5 0x0 0x0 0x0 0x1 0x1 0x1 0x6 0x0 0x0 0x0 0x1 0x0 0x1 0x7 0x0 0x0 0x0 0x1 0x1 0x1 0x8 0x0 0x0 0x0 0x1 0x1 0x1 0x9 0x0 0x0 0x0 0x1 0x0 0x1 0xa 0x0 0x0 0x0 0x1 0x0 0x1 0xb 0x0 0x0 0x0 0x1 0x1 0x1 0xc 0x0 0x0 0x0 0x1 0x1 0x0 0xd 0x0 0x1 0x0 0x0 0x0 0x0 0xe 0x0 0x1 0x0 0x0 0x0 0x0 0xf 0x0 0x1 0x0 0x0 0x0 0x0 0x10 0x0 0x0 0x0 0x1 0x1 0x1 0x11 0x1 0x0 0x0 0x1 0x0 0x0 0x12 0x1 0x1 0x0 0x0 0x0 0x0 0x13 0x1 0x1 0x0 0x0 0x0 0x0 0x14 0x1 0x1 0x0 0x0 0x0 0x0 0x15 0x0 0x1 0x0 0x0 0x0 0x0 0x16 0x0 0x1 0x0 0x0 0x0 0x0 0x17 0x0 0x1 0x0 0x0 0x0 0x0 0x18 0x0 0x1 0x0 0x0 0x0 0x0 0x19 0x1 0x0 0x0 0x1 0x0 0x0 0x1a 0x1 0x1 0x0 0x0 0x0 0x0 0x1c 0x1 0x0 0x0 0x1 0x1 0x1 0x1d 0x1 0x0 0x0 0x1 0x1 0x1 0x1e 0x0 0x1 0x0 0x0 0x0 0x0 0x1f 0x0 0x0 0x0 0x1 0x0 0x0 0x20 0x0 0x1 0x0 0x1 0x1 0x0 0x21 0x0 0x0 0x0 0x1 0x0 0x0 0x22 0x0 0x1 0x0 0x0 0x0 0x0 0x23 0x6 0x0 0x0 0x1 0x0 0x0 0x24 0x6 0x0 0x0 0x0 0x0 0x0 0x25 0x6 0x0 0x0 0x1 0x0 0x0 0x26 0x6 0x1 0x0 0x0 0x0 0x0 0x27 0x6 0x0 0x0 0x1 0x0 0x0 0x28 0x0 0x0 0x0 0x1 0x0 0x0 0x29 0x0 0x0 0x0 0x1 0x0 0x0 0x2a 0x0 0x0 0x0 0x1 0x0 0x0 0x2b 0x0 0x0 0x0 0x1 0x0 0x0 0x2c 0x0 0x1 0x0 0x0 0x0 0x0 0x2d 0x1 0x0 0x0 0x1 0x1 0x1 0x2e 0x1 0x0 0x0 0x1 0x1 0x1 0x2f 0x1 0x0 0x0 0x1 0x0 0x0 0x30 0x1 0x1 0x0 0x0 0x0 0x0 0x31 0x1 0x1 0x0 0x0 0x0 0x0 0x32 0x1 0x1 0x0 0x0 0x0 0x0 0x33 0x1 0x0 0x0 0x1 0x1 0x1 0x34 0x1 0x0 0x0 0x1 0x1 0x1 0x35 0x1 0x0 0x0 0x1 0x1 0x0 0x36 0x1 0x1 0x1 0x0 0x0 0x0 0x37 0x1 0x0 0x0 0x1 0x1 0x1 0x38 0x1 0x0 0x0 0x1 0x1 0x1 0x39 0x0 0x0 0x0 0x1 0x0 0x0 0x3a 0x0 0x0 0x0 0x1 0x0 0x0 0x3b 0x1 0x0 0x0 0x1 0x1 0x0 0x3c 0x0 0x0 0x0 0x1 0x0 0x0 0x3d 0x2 0x0 0x0 0x1 0x1 0x1 0x3e 0x2 0x0 0x0 0x1 0x1 0x1 0x3f 0x2 0x0 0x0 0x1 0x0 0x0 0x40 0x2 0x1 0x0 0x0 0x0 0x0 0x41 0x2 0x1 0x0 0x0 0x0 0x0 0x42 0x2 0x1 0x0 0x0 0x0 0x0 0x43 0x0 0x1 0x1 0x1 0x0 0x0 0x44 0x0 0x0 0x0 0x0 0x0 0x0 0x45 0x0 0x0 0x0 0x1 0x0 0x0 0x46 0x0 0x0 0x0 0x0 0x0 0x0 0x47 0x0 0x0 0x0 0x0 0x0 0x0 0x48 0x0 0x0 0x0 0x0 0x0 0x0 0x49 0x0 0x0 0x0 0x0 0x0 0x0 0x4a 0x3 0x0 0x0 0x1 0x0 0x0 0x4b 0x0 0x0 0x0 0x0 0x0 0x0 0x4c 0x1 0x0 0x0 0x1 0x0 0x0 0x4d 0x1 0x0 0x0 0x1 0x0 0x0 0x4e 0x1 0x0 0x0 0x1 0x0 0x0 0x4f 0x1 0x0 0x0 0x1 0x0 0x0 0x50 0x1 0x0 0x0 0x1 0x0 0x0 0x51 0x1 0x0 0x0 0x1 0x0 0x0 0x52 0x1 0x0 0x0 0x1 0x0 0x0 0x53 0x1 0x0 0x0 0x1 0x0 0x0 0x54 0x1 0x0 0x0 0x1 0x0 0x0 0x55 0x1 0x0 0x0 0x1 0x0 0x0 0x56 0x1 0x0 0x0 0x1 0x0 0x0 0x57 0x1 0x0 0x0 0x1 0x0 0x0 0x58 0x1 0x0 0x0 0x1 0x0 0x0 0x59 0x1 0x0 0x0 0x1 0x0 0x0 0x5a 0x1 0x0 0x0 0x1 0x0 0x0 0x5b 0x1 0x0 0x0 0x1 0x0 0x0 0x5c 0x1 0x0 0x0 0x1 0x0 0x0 0x5d 0x1 0x0 0x0 0x1 0x0 0x0 0x5e 0x1 0x0 0x0 0x1 0x0 0x0 0x5f 0x1 0x0 0x0 0x1 0x0 0x0 0x60 0x1 0x0 0x0 0x1 0x0 0x0 0x61 0x1 0x0 0x0 0x1 0x0 0x0 0x62 0x1 0x0 0x0 0x1 0x0 0x0 0x63 0x1 0x0 0x0 0x1 0x0 0x0 0x64 0x1 0x0 0x0 0x1 0x0 0x0 0x65 0x1 0x0 0x0 0x1 0x0 0x0 0x66 0x1 0x0 0x0 0x1 0x0 0x0 0x67 0x1 0x0 0x0 0x1 0x0 0x0 0x68 0x1 0x0 0x0 0x1 0x0 0x0 0x69 0x1 0x0 0x0 0x1 0x0 0x0 0x6a 0x1 0x0 0x0 0x1 0x0 0x0 0x6b 0x1 0x0 0x0 0x1 0x0 0x0 0x6c 0x1 0x0 0x0 0x1 0x0 0x0 0x6d 0x1 0x0 0x0 0x1 0x0 0x0 0x6e 0x1 0x0 0x0 0x1 0x1 0x1 0x6f 0x1 0x0 0x0 0x1 0x1 0x1 0x70 0x1 0x0 0x0 0x1 0x1 0x1 0x71 0x1 0x0 0x0 0x1 0x1 0x1 0x72 0x0 0x0 0x0 0x1 0x0 0x0 0x73 0x0 0x0 0x0 0x1 0x0 0x0 0x74 0x1 0x1 0x0 0x0 0x0 0x0 0x75 0x1 0x1 0x0 0x0 0x0 0x0 0x76 0x0 0x1 0x0 0x0 0x0 0x0 0x77 0x0 0x1 0x0 0x0 0x0 0x0 0x78 0x1 0x1 0x0 0x0 0x0 0x0 0x79 0x1 0x1 0x0 0x0 0x0 0x0 0x7a 0x0 0x0 0x0 0x1 0x0 0x0 0x7b 0x0 0x0 0x0 0x1 0x0 0x0 0x7c 0x0 0x1 0x0 0x0 0x0 0x0 0x7d 0x0 0x1 0x0 0x0 0x0 0x0 0x7e 0x0 0x1 0x0 0x0 0x0 0x0 0x7f 0x0 0x1 0x0 0x0 0x0 0x0 0x80 0x1 0x0 0x0 0x1 0x1 0x1 0x81 0x1 0x1 0x0 0x0 0x0 0x1 0x82 0x1 0x1 0x0 0x0 0x0 0x1 0x83 0x1 0x1 0x0 0x0 0x0 0x1 0x84 0x1 0x1 0x0 0x0 0x0 0x1 0x85 0x1 0x0 0x0 0x1 0x1 0x1 0x86 0x1 0x1 0x0 0x0 0x0 0x1 0x87 0x1 0x0 0x0 0x1 0x1 0x1 0x88 0x1 0x0 0x0 0x1 0x1 0x1 0x89 0x1 0x0 0x0 0x1 0x1 0x1 0x8a 0x1 0x0 0x0 0x1 0x1 0x1 0x8b 0x1 0x0 0x0 0x1 0x1 0x1 0x8c 0x1 0x0 0x0 0x1 0x1 0x1 0x8d 0x0 0x0 0x0 0x1 0x0 0x1 0x8e 0x1 0x1 0x0 0x0 0x0 0x0 0x8f 0x1 0x1 0x0 0x0 0x0 0x1 0x90 0x1 0x1 0x0 0x0 0x0 0x1 0x91 0x1 0x1 0x0 0x0 0x0 0x1 0x92 0x1 0x0 0x0 0x1 0x0 0x1 0x93 0x0 0x0 0x0 0x1 0x0 0x0 0x94 0x0 0x0 0x0 0x1 0x0 0x0 0x95 0x0 0x0 0x0 0x1 0x0 0x0 0x96 0x1 0x1 0x0 0x0 0x0 0x0 0x97 0x1 0x0 0x0 0x1 0x1 0x1 0x98 0x1 0x0 0x0 0x1 0x1 0x1 0x99 0x0 0x0 0x0 0x1 0x0 0x0 0x9a 0x0 0x0 0x0 0x1 0x0 0x0 0x9b 0x0 0x1 0x0 0x0 0x0 0x0 0x9c 0x0 0x1 0x0 0x0 0x0 0x0 0x9d 0x0 0x1 0x0 0x0 0x0 0x0 0x9e 0x0 0x1 0x0 0x0 0x0 0x0 0x9f 0x0 0x1 0x0 0x0 0x0 0x0 0xa0 0x0 0x1 0x0 0x0 0x0 0x0 0xa1 0x0 0x1 0x0 0x0 0x0 0x0 0xa2 0x0 0x1 0x0 0x0 0x0 0x0 0xa3 0x0 0x1 0x0 0x0 0x0 0x0 0xa4 0x0 0x1 0x0 0x0 0x0 0x0 0xa5 0x0 0x0 0x0 0x1 0x0 0x0 0xa6 0x0 0x0 0x0 0x1 0x0 0x0 0xa7 0x0 0x0 0x0 0x1 0x0 0x0 0xa8 0x0 0x0 0x0 0x1 0x0 0x0 0xa9 0x0 0x0 0x0 0x1 0x0 0x0 0xaa 0x0 0x0 0x0 0x1 0x0 0x0 0xab 0x0 0x0 0x0 0x1 0x0 0x0 0xac 0x0 0x0 0x0 0x1 0x0 0x0 0xad 0x0 0x0 0x0 0x1 0x0 0x0 0xae 0x0 0x0 0x0 0x1 0x0 0x0 0xaf 0x0 0x0 0x0 0x1 0x0 0x0 0xb0 0x0 0x0 0x0 0x1 0x0 0x0 0xb1 0x0 0x0 0x0 0x1 0x0 0x0 0xb2 0x0 0x0 0x0 0x1 0x0 0x0 0xb3 0x1 0x0 0x0 0x1 0x0 0x0 0xb4 0x1 0x0 0x0 0x1 0x0 0x0 0xb5 0x1 0x1 0x0 0x0 0x0 0x0 0xb6 0x1 0x1 0x0 0x0 0x0 0x0 0xb7 0x1 0x1 0x0 0x0 0x0 0x0 0xb8 0x1 0x0 0x0 0x1 0x0 0x0 0xb9 0x1 0x1 0x0 0x0 0x0 0x0 0xba 0x1 0x0 0x0 0x1 0x0 0x0 0xbb 0x1 0x1 0x0 0x0 0x0 0x0 0xbc 0x1 0x0 0x0 0x1 0x0 0x1 0xbd 0x1 0x1 0x0 0x0 0x0 0x1 0xbe 0x1 0x1 0x0 0x0 0x0 0x1 0xbf 0x1 0x1 0x0 0x0 0x0 0x1 0xc0 0x1 0x1 0x0 0x0 0x0 0x1 0xc1 0x1 0x0 0x0 0x1 0x0 0x1 0xc2 0x1 0x0 0x0 0x1 0x0 0x1 0xc3 0x0 0x1 0x0 0x0 0x0 0x0 0xc4 0x1 0x1 0x0 0x0 0x0 0x0 0xc5 0x0 0x1 0x0 0x0 0x0 0x0 0xc6 0x1 0x0 0x0 0x1 0x1 0x1 0xc7 0x1 0x0 0x0 0x1 0x1 0x1 0xc8 0x1 0x0 0x0 0x1 0x1 0x0 0xc9 0x1 0x1 0x0 0x0 0x0 0x0 0xca 0x0 0x1 0x0 0x0 0x0 0x0 0xcb 0x0 0x0 0x0 0x1 0x0 0x0 0xcc 0x0 0x0 0x0 0x1 0x0 0x0 0xcd 0x0 0x0 0x0 0x1 0x0 0x0 0xce 0x0 0x0 0x0 0x1 0x0 0x0 0xcf 0x0 0x0 0x0 0x1 0x0 0x0 0xd0 0x0 0x0 0x0 0x1 0x0 0x0 0xd1 0x0 0x0 0x0 0x1 0x0 0x0 0xd2 0x0 0x0 0x0 0x1 0x0 0x0>;
		};
	};

	fragment@39 {
		target = <0xffffffff>;

		__overlay__ {
			deb-gpios = <0xffffffff 0x0 0x0>;
			debounce = <0x7d000>;
			interrupt-parent = <0xffffffff>;
			interrupts = <0x0 0x8 0x0 0x0>;
			status = "okay";
		};
	};

	fragment@4 {
		target = <0xffffffff>;

		__overlay__ {

			eintdefault {
				phandle = <0x1>;
			};

			i2cmode_default {
				phandle = <0x6>;

				pins_cmd_dat {
					pinmux = <0x3301 0x3401>;
				};
			};

			int_active {
				phandle = <0x2>;

				pins_cmd_dat {
					bias-pill-up = <0x67>;
					input-enable;
					pinmux = <0x100>;
				};
			};

			int_high {
				phandle = <0x7>;

				pins_cmd_dat {
					output-high;
					pinmux = <0x100>;
				};
			};

			int_suspend {
				phandle = <0x4>;

				pins_cmd_dat {
					output-low;
					pinmux = <0x100>;
				};
			};

			reset_active {
				phandle = <0x3>;

				pins_cmd_dat {
					output-high;
					pinmux = <0x200>;
				};
			};

			reset_suspend {
				phandle = <0x5>;

				pins_cmd_dat {
					output-low;
					pinmux = <0x200>;
				};
			};
		};
	};

	fragment@40 {
		target = <0xffffffff>;

		__overlay__ {
			interrupt-parent = <0xffffffff>;
			interrupts = <0x1 0x2 0x1 0x0>;
			status = "okay";
		};
	};

	fragment@41 {
		target = <0xffffffff>;

		__overlay__ {
			interrupt-parent = <0xffffffff>;
			interrupts = <0x5 0x2 0x5 0x0>;
			status = "okay";
		};
	};

	fragment@42 {
		target = <0xffffffff>;

		__overlay__ {
			interrupt-parent = <0xffffffff>;
			interrupts = <0x7 0x2 0x7 0x0>;
			status = "okay";
		};
	};

	fragment@43 {
		target = <0xffffffff>;

		__overlay__ {
			interrupt-parent = <0xffffffff>;
			interrupts = <0x8 0x8 0x8 0x0>;
			status = "okay";
		};
	};

	fragment@44 {
		target = <0xffffffff>;

		__overlay__ {
			interrupt-parent = <0xffffffff>;
			interrupts = <0x10 0x2 0x10 0x0>;
			status = "okay";
		};
	};

	fragment@45 {
		target = <0xffffffff>;

		__overlay__ {
			interrupt-parent = <0xffffffff>;
			interrupts = <0x1f 0x4 0x1f 0x0>;
			status = "okay";
		};
	};

	fragment@46 {
		target = <0xffffffff>;

		__overlay__ {
			interrupt-parent = <0xffffffff>;
			interrupts = <0x2b 0x1 0x2b 0x0>;
			status = "okay";
		};
	};

	fragment@47 {
		target = <0xffffffff>;

		__overlay__ {
			deb-gpios = <0xffffffff 0x48 0x0>;
			debounce = <0x7d000>;
			interrupt-parent = <0xffffffff>;
			interrupts = <0x48 0x8 0x48 0x0>;
			status = "okay";
		};
	};

	fragment@48 {
		target = <0xffffffff>;

		__overlay__ {
			deb-gpios = <0xffffffff 0x4b 0x0>;
			debounce = <0x7d000>;
			interrupt-parent = <0xffffffff>;
			interrupts = <0x4b 0x8 0x4b 0x0>;
			status = "okay";
		};
	};

	fragment@49 {
		target = <0xffffffff>;

		__overlay__ {
			interrupt-parent = <0xffffffff>;
			interrupts = <0xc1 0x4 0xd1 0x0>;
			status = "okay";
		};
	};

	fragment@5 {
		target = <0xffffffff>;

		__overlay__ {

			fpc_tee@0 {
				#vfp-supply = <0xffffffff>;
				compatible = "fpc,fpc_spi";
				fpc,enable-wakeup;
				netlink-event = <0x1f>;
				power-type = <0x1>;
				reg = <0x0>;
				spi-max-frequency = <0x989680>;
				status = "okay";
			};
		};
	};

	fragment@50 {
		target = <0xffffffff>;

		__overlay__ {
			compatible = "mediatek,md1_sim1_hot_plug_eint-eint";
			debounce = <0x0 0xc350>;
			dedicated = <0x0 0x0>;
			interrupts = <0x0 0x8>;
			sockettype = <0x0 0x0>;
			src_pin = <0x0 0x1>;
			status = "okay";
		};
	};

	fragment@51 {
		target = <0xffffffff>;

		__overlay__ {
			regulator-default-on = <0x1>;
			regulator-name = "vcamio";
			status = "okay";
		};
	};

	fragment@52 {
		target = <0xffffffff>;

		__overlay__ {
			regulator-default-on = <0x1>;
			regulator-name = "vtp";
			status = "okay";
		};
	};

	fragment@53 {
		target = <0xffffffff>;

		__overlay__ {
			status = "okay";
			vcamaf-supply = <0xffffffff>;
			vcamaf_main2-supply = <0xffffffff>;
			vcamio-supply = <0xffffffff>;
			vcamio_main2-supply = <0xffffffff>;
			vcamio_sub-supply = <0xffffffff>;
		};
	};

	fragment@54 {
		target = <0xffffffff>;

		__overlay__ {
			status = "okay";
			vtouch-supply = <0xffffffff>;
		};
	};

	fragment@55 {
		target = <0xffffffff>;

		__overlay__ {
			mediatek,kpd-hw-dl-key0 = <0x11>;
			mediatek,kpd-hw-dl-key1 = <0x0>;
			mediatek,kpd-hw-dl-key2 = <0x8>;
			mediatek,kpd-hw-factory-key = <0x0>;
			mediatek,kpd-hw-init-map = <0x72 0x0 0x0 0x0 0x0 0x0 0x0 0x0 0x0 0x0 0x0 0x0 0x0 0x0 0x0 0x0 0x0 0x0 0x0 0x0 0x0 0x0 0x0 0x0 0x0 0x0 0x0 0x0 0x0 0x0 0x0 0x0 0x0 0x0 0x0 0x0 0x0 0x0 0x0 0x0 0x0 0x0 0x0 0x0 0x0 0x0 0x0 0x0 0x0 0x0 0x0 0x0 0x0 0x0 0x0 0x0 0x0 0x0 0x0 0x0 0x0 0x0 0x0 0x0 0x0 0x0 0x0 0x0 0x0 0x0 0x0 0x0>;
			mediatek,kpd-hw-map-num = <0x48>;
			mediatek,kpd-hw-pwrkey = <0x8>;
			mediatek,kpd-hw-recovery-key = <0x11>;
			mediatek,kpd-hw-rstkey = <0x11>;
			mediatek,kpd-key-debounce = <0x400>;
			mediatek,kpd-pwkey-gpio-din = <0x0>;
			mediatek,kpd-pwrkey-eint-gpio = <0x0>;
			mediatek,kpd-sw-pwrkey = <0x74>;
			mediatek,kpd-sw-rstkey = <0x73>;
			mediatek,kpd-use-extend-type = <0x0>;
			status = "okay";
		};
	};

	fragment@56 {
		target = <0xffffffff>;

		__overlay__ {

			camdefault {
				phandle = <0x2a>;
			};

			camera0_mclk_2ma@gpio116 {
				phandle = <0x3a>;

				pins_cmd_dat {
					drive-strength = <0x0>;
					pinmux = <0x7401>;
				};
			};

			camera0_mclk_4ma@gpio116 {
				phandle = <0x3b>;

				pins_cmd_dat {
					drive-strength = <0x1>;
					pinmux = <0x7401>;
				};
			};

			camera0_mclk_6ma@gpio116 {
				phandle = <0x3c>;

				pins_cmd_dat {
					drive-strength = <0x2>;
					pinmux = <0x7401>;
				};
			};

			camera0_mclk_8ma@gpio116 {
				phandle = <0x3d>;

				pins_cmd_dat {
					drive-strength = <0x3>;
					pinmux = <0x7401>;
				};
			};

			camera0_mclk_gpio_mode@gpio116 {
				phandle = <0x39>;

				pins_cmd_dat {
					drive-strength = <0x1>;
					pinmux = <0x7400>;
				};
			};

			camera0_rst_output_high@gpio118 {
				phandle = <0x2c>;

				pins_cmd_dat {
					output-high;
					pinmux = <0x7600>;
				};
			};

			camera0_rst_output_low@gpio118 {
				phandle = <0x2b>;

				pins_cmd_dat {
					output-low;
					pinmux = <0x7600>;
				};
			};

			camera1_mclk_2ma@gpio120 {
				phandle = <0x41>;

				pins_cmd_dat {
					drive-strength = <0x0>;
					pinmux = <0x7801>;
				};
			};

			camera1_mclk_4ma@gpio120 {
				phandle = <0x42>;

				pins_cmd_dat {
					drive-strength = <0x1>;
					pinmux = <0x7801>;
				};
			};

			camera1_mclk_6ma@gpio120 {
				phandle = <0x43>;

				pins_cmd_dat {
					drive-strength = <0x2>;
					pinmux = <0x7801>;
				};
			};

			camera1_mclk_8ma@gpio120 {
				phandle = <0x44>;

				pins_cmd_dat {
					drive-strength = <0x3>;
					pinmux = <0x7801>;
				};
			};

			camera1_mclk_gpio_mode@gpio120 {
				phandle = <0x40>;

				pins_cmd_dat {
					drive-strength = <0x1>;
					pinmux = <0x7800>;
				};
			};

			camera1_mipisel_off@gpio21 {
				phandle = <0x3e>;

				pins_cmd_dat {
					output-low;
					pinmux = <0x1500>;
				};
			};

			camera1_mipisel_on@gpio21 {
				phandle = <0x3f>;

				pins_cmd_dat {
					output-high;
					pinmux = <0x1500>;
				};
			};

			camera1_rst_output_high@gpio124 {
				phandle = <0x2e>;

				pins_cmd_dat {
					output-high;
					pinmux = <0x7c00>;
				};
			};

			camera1_rst_output_low@gpio124 {
				phandle = <0x2d>;

				pins_cmd_dat {
					output-low;
					pinmux = <0x7c00>;
				};
			};

			camera2_mclk_2ma@gpio121 {
				phandle = <0x46>;

				pins_cmd_dat {
					drive-strength = <0x0>;
					pinmux = <0x7901>;
				};
			};

			camera2_mclk_4ma@gpio121 {
				phandle = <0x47>;

				pins_cmd_dat {
					drive-strength = <0x1>;
					pinmux = <0x7901>;
				};
			};

			camera2_mclk_6ma@gpio121 {
				phandle = <0x48>;

				pins_cmd_dat {
					drive-strength = <0x2>;
					pinmux = <0x7901>;
				};
			};

			camera2_mclk_8ma@gpio121 {
				phandle = <0x49>;

				pins_cmd_dat {
					drive-strength = <0x3>;
					pinmux = <0x7901>;
				};
			};

			camera2_mclk_gpio_mode@gpio121 {
				phandle = <0x45>;

				pins_cmd_dat {
					drive-strength = <0x1>;
					pinmux = <0x7900>;
				};
			};

			camera2_rst_output_high@gpio125 {
				phandle = <0x30>;

				pins_cmd_dat {
					output-high;
					pinmux = <0x7d00>;
				};
			};

			camera2_rst_output_low@gpio125 {
				phandle = <0x2f>;

				pins_cmd_dat {
					output-low;
					pinmux = <0x7d00>;
				};
			};

			camera3_mclk_2ma@gpio196 {
				phandle = <0x4b>;

				pins_cmd_dat {
					drive-strength = <0x0>;
					pinmux = <0xc401>;
				};
			};

			camera3_mclk_4ma@gpio196 {
				phandle = <0x4c>;

				pins_cmd_dat {
					drive-strength = <0x1>;
					pinmux = <0xc401>;
				};
			};

			camera3_mclk_6ma@gpio196 {
				phandle = <0x4d>;

				pins_cmd_dat {
					drive-strength = <0x2>;
					pinmux = <0xc401>;
				};
			};

			camera3_mclk_8ma@gpio196 {
				phandle = <0x4e>;

				pins_cmd_dat {
					drive-strength = <0x3>;
					pinmux = <0xc401>;
				};
			};

			camera3_mclk_gpio_mode@gpio196 {
				phandle = <0x4a>;

				pins_cmd_dat {
					drive-strength = <0x1>;
					pinmux = <0xc400>;
				};
			};

			camera3_rst_output_high@gpio197 {
				phandle = <0x32>;

				pins_cmd_dat {
					output-high;
					pinmux = <0xc500>;
				};
			};

			camera3_rst_output_low@gpio197 {
				phandle = <0x31>;

				pins_cmd_dat {
					output-low;
					pinmux = <0xc500>;
				};
			};

			camera3_vcamio_output_high@gpio22 {
				phandle = <0x36>;

				pins_cmd_dat {
					output-high;
					pinmux = <0x1600>;
				};
			};

			camera3_vcamio_output_low@gpio22 {
				phandle = <0x35>;

				pins_cmd_dat {
					output-low;
					pinmux = <0x1600>;
				};
			};

			camera4_mclk_2ma@gpio117 {
				phandle = <0x50>;

				pins_cmd_dat {
					drive-strength = <0x0>;
					pinmux = <0x7501>;
				};
			};

			camera4_mclk_4ma@gpio117 {
				phandle = <0x51>;

				pins_cmd_dat {
					drive-strength = <0x1>;
					pinmux = <0x7501>;
				};
			};

			camera4_mclk_6ma@gpio117 {
				phandle = <0x52>;

				pins_cmd_dat {
					drive-strength = <0x2>;
					pinmux = <0x7501>;
				};
			};

			camera4_mclk_8ma@gpio117 {
				phandle = <0x53>;

				pins_cmd_dat {
					drive-strength = <0x3>;
					pinmux = <0x7501>;
				};
			};

			camera4_mclk_gpio_mode@gpio117 {
				phandle = <0x4f>;

				pins_cmd_dat {
					drive-strength = <0x1>;
					pinmux = <0x7500>;
				};
			};

			camera4_rst_output_high@gpio119 {
				phandle = <0x34>;

				pins_cmd_dat {
					output-high;
					pinmux = <0x7700>;
				};
			};

			camera4_rst_output_low@gpio119 {
				phandle = <0x33>;

				pins_cmd_dat {
					output-low;
					pinmux = <0x7700>;
				};
			};

			camera4_vcamio_output_high@gpio22 {
				phandle = <0x38>;

				pins_cmd_dat {
					output-high;
					pinmux = <0x1600>;
				};
			};

			camera4_vcamio_output_low@gpio22 {
				phandle = <0x37>;

				pins_cmd_dat {
					output-low;
					pinmux = <0x1600>;
				};
			};
		};
	};

	fragment@57 {
		target = <0xffffffff>;

		__overlay__ {
			cam0_vcama-supply = <0x55>;
			cam0_vcamd-supply = <0x54>;
			cam0_vcamio-supply = <0xffffffff>;
			cam1_vcama-supply = <0x56>;
			cam1_vcamd-supply = <0x57>;
			cam1_vcamio-supply = <0xffffffff>;
			cam2_vcama-supply = <0x56>;
			cam2_vcamd-supply = <0x57>;
			cam2_vcamio-supply = <0xffffffff>;
			cam3_vcama-supply = <0x56>;
			cam4_vcama-supply = <0x56>;
			pinctrl-0 = <0x2a>;
			pinctrl-1 = <0x2b>;
			pinctrl-10 = <0x34>;
			pinctrl-11 = <0x35>;
			pinctrl-12 = <0x36>;
			pinctrl-13 = <0x37>;
			pinctrl-14 = <0x38>;
			pinctrl-15 = <0x39>;
			pinctrl-16 = <0x3a>;
			pinctrl-17 = <0x3b>;
			pinctrl-18 = <0x3c>;
			pinctrl-19 = <0x3d>;
			pinctrl-2 = <0x2c>;
			pinctrl-20 = <0x3e>;
			pinctrl-21 = <0x3f>;
			pinctrl-22 = <0x40>;
			pinctrl-23 = <0x41>;
			pinctrl-24 = <0x42>;
			pinctrl-25 = <0x43>;
			pinctrl-26 = <0x44>;
			pinctrl-27 = <0x45>;
			pinctrl-28 = <0x46>;
			pinctrl-29 = <0x47>;
			pinctrl-3 = <0x2d>;
			pinctrl-30 = <0x48>;
			pinctrl-31 = <0x49>;
			pinctrl-32 = <0x4a>;
			pinctrl-33 = <0x4b>;
			pinctrl-34 = <0x4c>;
			pinctrl-35 = <0x4d>;
			pinctrl-36 = <0x4e>;
			pinctrl-37 = <0x4f>;
			pinctrl-38 = <0x50>;
			pinctrl-39 = <0x51>;
			pinctrl-4 = <0x2e>;
			pinctrl-40 = <0x52>;
			pinctrl-41 = <0x53>;
			pinctrl-5 = <0x2f>;
			pinctrl-6 = <0x30>;
			pinctrl-7 = <0x31>;
			pinctrl-8 = <0x32>;
			pinctrl-9 = <0x33>;
			pinctrl-names = "default", "cam0_rst0", "cam0_rst1", "cam1_rst0", "cam1_rst1", "cam2_rst0", "cam2_rst1", "cam3_rst0", "cam3_rst1", "cam4_rst0", "cam4_rst1", "cam3_ldo_vcamio_0", "cam3_ldo_vcamio_1", "cam4_ldo_vcamio_0", "cam4_ldo_vcamio_1", "cam0_mclk_off", "cam0_mclk_2mA", "cam0_mclk_4mA", "cam0_mclk_6mA", "cam0_mclk_8mA", "cam_mipi_switch_sel_0", "cam_mipi_switch_sel_1", "cam1_mclk_off", "cam1_mclk_2mA", "cam1_mclk_4mA", "cam1_mclk_6mA", "cam1_mclk_8mA", "cam2_mclk_off", "cam2_mclk_2mA", "cam2_mclk_4mA", "cam2_mclk_6mA", "cam2_mclk_8mA", "cam3_mclk_off", "cam3_mclk_2mA", "cam3_mclk_4mA", "cam3_mclk_6mA", "cam3_mclk_8mA", "cam4_mclk_off", "cam4_mclk_2mA", "cam4_mclk_4mA", "cam4_mclk_6mA", "cam4_mclk_8mA";
			status = "okay";
		};
	};

	fragment@58 {
		target = <0xffffffff>;

		__overlay__ {

			cam0_ldo_vcamaf_output_high@gpio34 {
				phandle = <0xb>;

				pins_cmd_dat {
					output-high;
					pinmux = <0x2200>;
				};
			};

			cam0_ldo_vcamaf_output_low@gpio34 {
				phandle = <0xa>;

				pins_cmd_dat {
					output-low;
					pinmux = <0x2200>;
				};
			};
		};
	};

	fragment@59 {
		target = <0xffffffff>;

		__overlay__ {
			cam0_enable_sensor = "ov64b40semco_mipi_raw ov64b40ofilm_mipi_raw";
			cam1_enable_sensor = "ov13b10sunny_mipi_raw ov13b10ofilm_mipi_raw";
			cam2_enable_sensor = "imx355ofilm_mipi_raw imx355sunny_mipi_raw";
			cam3_enable_sensor = "ov02b1bofilm_mipi_raw gc02m1bsunny_mipi_mono";
			cam4_enable_sensor = "gc02m1ofilm_mipi_raw gc02m1sunny_mipi_raw";
		};
	};

	fragment@6 {
		target = <0xffffffff>;

		__overlay__ {
			pinctrl-0 = <0x8>;
			pinctrl-1 = <0x9>;
			pinctrl-names = "fpsensor_fpc_rst_low", "fpsensor_fpc_rst_high";
			status = "okay";
		};
	};

	fragment@60 {
		target = <0xffffffff>;

		__overlay__ {

			wl2866d@28 {
				compatible = "xiaomi,wl2866d";
				en-gpio = <0xffffffff 0xc3 0x0>;
				phandle = <0x78>;
				reg = <0x28>;

				wl2866d_avdd1@2 {
					init-voltage = <0x2ab980>;
					iout_ua = <0x9eb10>;
					min-dropout-voltage = <0x15f90>;
					offset = [00 02];
					phandle = <0x56>;
					regulator-max-microvolt = <0x42f2ac>;
					regulator-min-microvolt = <0x124f80>;
					regulator-name = "wl2866d_avdd1";
				};

				wl2866d_avdd2@3 {
					init-voltage = <0x2ab980>;
					iout_ua = <0x9eb10>;
					min-dropout-voltage = <0x15f90>;
					offset = [00 03];
					phandle = <0x55>;
					regulator-max-microvolt = <0x42f2ac>;
					regulator-min-microvolt = <0x124f80>;
					regulator-name = "wl2866d_avdd2";
				};

				wl2866d_dvdd1@0 {
					init-voltage = <0x124f80>;
					iout_ua = <0x9eb10>;
					min-dropout-voltage = <0x13880>;
					offset = [00 00];
					phandle = <0x57>;
					regulator-max-microvolt = <0x208050>;
					regulator-min-microvolt = <0x927c0>;
					regulator-name = "wl2866d_dvdd1";
				};

				wl2866d_dvdd2@1 {
					init-voltage = <0x100590>;
					iout_ua = <0x9eb10>;
					min-dropout-voltage = <0x11940>;
					offset = [00 01];
					phandle = <0x54>;
					regulator-max-microvolt = <0x208050>;
					regulator-min-microvolt = <0x927c0>;
					regulator-name = "wl2866d_dvdd2";
				};
			};
		};
	};

	fragment@61 {
		target = <0xffffffff>;

		__overlay__ {

			speaker_amp@34 {
				phandle = <0x79>;
				status = "disabled";
			};
		};
	};

	fragment@62 {
		target = <0xffffffff>;

		__overlay__ {

			aw87xxx_pa_58@58 {
				compatible = "awinic,aw87xxx_pa";
				monitor-flag = <0x1>;
				monitor-timer-count-max = <0x5>;
				monitor-timer-val = <0xbb8>;
				pa-channel = <0x1>;
				reg = <0x58>;
				status = "okay";
			};

			aw87xxx_pa_5B@5B {
				compatible = "awinic,aw87xxx_pa";
				monitor-flag = <0x1>;
				monitor-timer-count-max = <0x5>;
				monitor-timer-val = <0xbb8>;
				pa-channel = <0x0>;
				reg = <0x5b>;
				reset-gpio = <0xffffffff 0x18 0x0>;
				status = "okay";
			};
		};
	};

	fragment@7 {
		target = <0xffffffff>;

		__overlay__ {

			fpsensor_fpc_rst_high {
				phandle = <0x9>;

				pins_cmd_dat {
					output-high;
					pinmux = <0x1e00>;
					slew-rate = <0x1>;
				};
			};

			fpsensor_fpc_rst_low {
				phandle = <0x8>;

				pins_cmd_dat {
					output-low;
					pinmux = <0x1e00>;
					slew-rate = <0x1>;
				};
			};
		};
	};

	fragment@8 {
		target = <0xffffffff>;

		__overlay__ {
		};
	};

	fragment@9 {
		target = <0xffffffff>;

		__overlay__ {
			atag,videolfb-fb_base_h = <0x0>;
			atag,videolfb-fb_base_l = "~`P";
			atag,videolfb-fps = <0x1770>;
			atag,videolfb-islcm_inited = <0x0>;
			atag,videolfb-islcmfound = <0x1>;
			atag,videolfb-lcmname = "nt35695_fhd_dsi_cmd_truly_rt5081_drv";
			atag,videolfb-vramSize = <0x17e8000>;
		};
	};
};
